/**
 * Bounces the Makeability Lab logo around the screen
 * 
 * To create the byte dumps of the images, I used the image2cpp tool here: 
 * http://javl.github.io/image2cpp/
 * 
 * By Jon E. Froehlich
 * @jonfroehlich
 * http://makeabilitylab.io
 *
 */

#include <SPI.h>
#include <Wire.h>
#include <Adafruit_GFX.h>
#include <Adafruit_SSD1306.h>

#define SCREEN_WIDTH 128 // OLED display width, in pixels
#define SCREEN_HEIGHT 64 // OLED display height, in pixels

// Declaration for an SSD1306 display connected to I2C (SDA, SCL pins)
#define OLED_RESET     4 // Reset pin # (or -1 if sharing Arduino reset pin)
Adafruit_SSD1306 _display(SCREEN_WIDTH, SCREEN_HEIGHT, &Wire, OLED_RESET);

const int LOGO_WIDTH = 50;
const int LOGO_HEIGHT = 35;

// 'logo_bw_no_text_600w', 50x35px
const unsigned char PROGMEM _logoBitmap []  = {
  0x00, 0x80, 0x00, 0x00, 0x00, 0x40, 0x00, 0x01, 0x40, 0x00, 0x00, 0x00, 0xe0, 0x00, 0x02, 0x20, 
  0x00, 0x00, 0x01, 0x50, 0x00, 0x04, 0x10, 0x00, 0x00, 0x02, 0x48, 0x00, 0x08, 0x08, 0x00, 0x00, 
  0x04, 0x44, 0x00, 0x10, 0x04, 0x00, 0x00, 0x08, 0x42, 0x00, 0x20, 0x02, 0x00, 0x00, 0x10, 0x41, 
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  0x00, 0x00, 0x00, 0x00, 0x00
};

int _xLogo = 0;   // x location of logo (in pixels)
int _yLogo = 0;   // y location of logo (in pixels)
int _xSpeed = 1;  // x speed of logo (in pixels per frame)
int _ySpeed = 2;  // y speed of logo (in pixels per frame)

void setup() {
  Serial.begin(9600);

  // SSD1306_SWITCHCAPVCC = generate display voltage from 3.3V internally
  if(!_display.begin(SSD1306_SWITCHCAPVCC, 0x3D)) { // Address 0x3D for 128x64
    Serial.println(F("SSD1306 allocation failed"));
    for(;;); // Don't proceed, loop forever
  }

  // We need to randomly seed our random number generator, which we can
  // do with noise off of A5 (assuming nothing is attached to it)
  randomSeed(analogRead(A5));

  // Get random x, y speed
  _xSpeed = random(1, 4);
  _ySpeed = random(1, 4);

  // Clear the buffer
  _display.clearDisplay();
}

void loop() {
  _display.clearDisplay();

  // Draw the bitmap
  _display.drawBitmap(_xLogo, _yLogo,  _logoBitmap, LOGO_WIDTH, LOGO_HEIGHT, WHITE);
  _display.display();

  // Move the logo
  _xLogo += _xSpeed;
  _yLogo += _ySpeed;

  // Check if the logo hits the sides of the screen, if so, reverse direction
  if(_xLogo < 0 || _xLogo + LOGO_WIDTH > _display.width()){
    _xSpeed *= -1;
  }

  if(_yLogo < 0 || _yLogo + LOGO_HEIGHT > _display.height()){
    _ySpeed *= -1;
  }
  
  delay(20); 
}
